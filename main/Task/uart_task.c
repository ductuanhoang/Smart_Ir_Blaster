/*
 * uart_task.c
 *
 *  Created on: Nov 24, 2020
 *      Author: Yolo
 */
/***********************************************************************************************************************
* Pragma directive
***********************************************************************************************************************/

/***********************************************************************************************************************
* Includes <System Includes>
***********************************************************************************************************************/
#include "uart_task.h"
#include "../Interface/shell/vsm_retarget.h"
#include "../Interface/shell/app_cli.h"
#include "../Interface/UserUart.h"
#include "../Interface/Logger_File/logger_file.h"

#include "../json_parser/json_parser.h"
/***********************************************************************************************************************
* Macro definitions
***********************************************************************************************************************/

/***********************************************************************************************************************
* Typedef definitions
***********************************************************************************************************************/

/***********************************************************************************************************************
* Private global variables and functions
***********************************************************************************************************************/

/***********************************************************************************************************************
* Exported global variables and functions (to be accessed by other files)
***********************************************************************************************************************/
static void uart_control_task(void *pvParameters);

/***********************************************************************************************************************
* Imported global variables and functions (from other files)
***********************************************************************************************************************/

/***********************************************************************************************************************
* Function Name: 
* Description  :
* Arguments    : none
* Return Value : none
***********************************************************************************************************************/
void uart_task(void *pvParameters)
{
	vTaskDelay(100);
	while (1)
	{
		vsm_cli_main_loop(NULL);
		vTaskDelay(1);
	}
}

void uart_command_start(void)
{
	xTaskCreate(uart_control_task, "uart_control_task", 6 * 1024, NULL, 4 | portPRIVILEGE_BIT, NULL);
}
/***********************************************************************************************************************
* Function Name:
* Description  :
* Arguments    : none
* Return Value : none
***********************************************************************************************************************/
static void uart_control_task(void *pvParameters)
{
	uint8_t data[512] = {0};
//	uint8_t test[12] = "hello\r\n";
	unsigned char Rx_len = 0;
	vTaskDelay(1000);
	printf("\r\n---- Uart_Task start with Baudrate = %d ......\r\n", UART_BAUD_115200);
	UserUart_2_Init(UART_BAUD_115200);

	while(1)
	{
		if((Rx_len = UserUart_ReadData(data)) > 0)
		{
//			UserUart_UartRxCallBack((unsigned char*)data, Rx_len, true);
			bool status = json_parser_message((const char*)data, E_SOURCE_FROM_UART);
			memset(data, 0x00, sizeof(data));
		}
		vTaskDelay(10);
	}
}
/***********************************************************************************************************************
* static functions
***********************************************************************************************************************/

/***********************************************************************************************************************
* Function Name:
* Description  : message :
* Arguments    : none
* Return Value : none
***********************************************************************************************************************/
void uart_control_parser_message(char *message)
{
    int *data;
    int index = 0;
    int buffer_index = 0;
    char *p;
    data = (int *)malloc(512 + 1);
    if (data == NULL)
        exit(1);

    p = strtok(message, "!,\n"); //cat chuoi bang cac ky tu ,. va space
    while (p != NULL)
    {
        if (index == 0)
        {
            //TODO
        }
        else
        {
            data[buffer_index++] = atoi(p);
        }
        index++;
        p = strtok(NULL, "!,\n"); //cat chuoi tu vi tri dung lai truoc do
    }
}
/***********************************************************************************************************************
* End of file
***********************************************************************************************************************/
